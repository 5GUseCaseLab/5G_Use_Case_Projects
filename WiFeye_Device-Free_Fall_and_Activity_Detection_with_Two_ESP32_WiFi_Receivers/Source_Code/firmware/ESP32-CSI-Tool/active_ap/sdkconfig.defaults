## WiFeye_Device-Free_Fall_and_Activity_Detection_with_Two_ESP32_WiFi_Receivers/Source_Code/firmware/ESP32-CSI-Tool/active_ap/sdkconfig.defaults
```kconfig
CONFIG_IDF_TARGET="esp32"
CONFIG_ESPTOOLPY_MONITOR_BAUD_OTHER=y
CONFIG_ESPTOOLPY_MONITOR_BAUD_OTHER_VAL=921600
CONFIG_ESPTOOLPY_MONITOR_BAUD=921600
CONFIG_ESP_CONSOLE_UART_CUSTOM=y
CONFIG_ESP_CONSOLE_UART_BAUDRATE=921600
CONFIG_ESP32_WIFI_CSI_ENABLED=y
CONFIG_FREERTOS_HZ=1000
```

## WiFeye_Device-Free_Fall_and_Activity_Detection_with_Two_ESP32_WiFi_Receivers/Source_Code/firmware/ESP32-CSI-Tool/active_sta/sdkconfig.defaults
```kconfig
CONFIG_IDF_TARGET="esp32"
CONFIG_ESPTOOLPY_MONITOR_BAUD_OTHER=y
CONFIG_ESPTOOLPY_MONITOR_BAUD_OTHER_VAL=921600
CONFIG_ESPTOOLPY_MONITOR_BAUD=921600
CONFIG_ESP_CONSOLE_UART_CUSTOM=y
CONFIG_ESP_CONSOLE_UART_BAUDRATE=921600
CONFIG_ESP32_WIFI_CSI_ENABLED=y
CONFIG_FREERTOS_HZ=1000
CONFIG_ESP_WIFI_SSID="CSI"
CONFIG_ESP_WIFI_PASSWORD="YOUR_WIFI_PASSWORD"
CONFIG_SHOULD_COLLECT_CSI=y
CONFIG_SHOULD_COLLECT_ONLY_LLTF=y
CONFIG_SEND_CSI_TO_SERIAL=y
```
